## rp2040/Kconfig
```kconfig
mainmenu "GBLink Device Settings"
source "Kconfig.zephyr"

menu "Application Options"
    config SECTIONS_USE_MASTER_MODE
    bool "Use master mode to connect"
    default y
    help
        Use master mode to connect. 
        Disbale for slave mode to help debug slave setting
        WARNING for future Nils: This will probably not work since Game saves player under player ID which will swap if
        in next section device will switch to master. Why it works in "disconnect" is unkown, but probably due to slightly
        different code paths. To confirm see "DoesLinkPlayerCountMatchSaved" and change accordingly 

    config GB_LINK_MODE_ENABLED
    bool "Enable Game Boy link mode"
    default y
    help
        Enable support for Game Boy link communication.
        This adds the GB SPI passthrough and printer modes.

    config GB_LINK_DRIVE_SD_LOW
    bool "Drive SD pin LOW in GB link mode (generic GBC cable GBA support)"
    default n
    depends on GB_LINK_MODE_ENABLED
    help
        Drive the SD pin (pin 4 of the link connector) LOW whenever GB link
        mode is active.

        OEM GBC link cables leave pin 4 unconnected, so this has no effect
        on them. Generic GBC cables wire all 6 pins through, including pin 4,
        which means the SD signal actually reaches the GBA.

        The GBA reads SIOCNT bit 3 (SD state) to detect whether an external
        clock master is present. With SD floating HIGH (the default when this
        option is off) the GBA may not recognise the adapter as the master,
        causing GBA-mode transfers to fail. Driving SD LOW tells the GBA that
        an external device is driving the clock, which is the correct state
        when the adapter is acting as SPI master.

    config GB_LINK_RFU_IGNORE_SD
    bool "Wireless adapter mode: ignore the SD soft-reset pins (4-wire cables)"
    default n
    help
        Do not arm GP3/GP4 as soft-reset inputs in mode 07. On a 4-wire GBC
        cable the GBA's SD pulse never reaches the adapter; the unconnected,
        weakly pulled-down pins instead pick up SC/SO/SI switching and the
        qualified pulses read as AgbRFU_SoftReset, wiping all link state while
        the game is in a room (kizuna-duo docs/69 §9: six false resets in one
        session, room crash; zero resets and a stable room with the inputs
        off). Login restarts are still caught in-band through 0x494E.

        Enable this option when using a generic GBC cable to connect to a GBA
        (e.g. for Gen 3 trading or multiboot). Safe to leave enabled even with
        OEM cables or original GB/GBC hardware — those devices either ignore
        the SD pin or treat SD LOW as a valid "external master" signal.

endmenu
```

## switch-online/esp/components/cport/Kconfig
```kconfig
menu "cport (FRLG LDN brain)"
    config CPORT_ZSTD_NO_COMPRESS
        bool "Leave out the zstd compressor and its 40 KB static workspace (send stored zstd frames)"
        default n
        help
            The join-role simulator (sim.c) compresses the Pia payloads it sends. A host-only image (hosted-trade) sends
            stored zstd blocks (pia_host_zstd_stored) and never compresses, so the ~40 KB compression workspace in
            pia_zstd.c is dead RAM there. With this set pia_compress() emits a stored (uncompressed) zstd frame in the
            console's canonical header instead of compressing; decompression is unaffected.
endmenu
```
